#include <LovyanGFX.hpp>
#include <math.h>

class LGFX : public lgfx::LGFX_Device {
  lgfx::Panel_ST7796 _panel;
  lgfx::Bus_Parallel8 _bus;
  lgfx::Touch_FT5x06 _touch;

public:
  LGFX() {
    auto cfg = _bus.config();
    cfg.freq_write = 20000000;
    cfg.pin_wr = 47;
    cfg.pin_rs = 0;
    cfg.pin_d0 = 9; cfg.pin_d1 = 46; cfg.pin_d2 = 3; cfg.pin_d3 = 8; cfg.pin_d4 = 18; cfg.pin_d5 = 17; cfg.pin_d6 = 16; cfg.pin_d7 = 15;
    _bus.config(cfg);
    _panel.setBus(&_bus);

    auto panel_cfg = _panel.config();
    panel_cfg.pin_rst = 4;
    panel_cfg.panel_width = 320;
    panel_cfg.panel_height = 480;
    _panel.config(panel_cfg);
    setPanel(&_panel);

    auto touch_cfg = _touch.config();
    touch_cfg.i2c_port = 1;
    touch_cfg.pin_sda = 6;  
    touch_cfg.pin_scl = 5;  
    touch_cfg.pin_int = 7;  
    _touch.config(touch_cfg);
  }

  void initTouch() {_touch.init();}

  bool getTouch(int16_t* x, int16_t* y) {
    lgfx::v1::touch_point_t tp;
    bool touch = false;

    if (_touch.getTouchRaw(&tp, 1)){
      *x = 320-tp.x;
      *y = 480-tp.y;
      touch = true;
    }
    return touch;
  }
};

const int IMAGE_HEIGHT = 32;
const int IMAGE_WIDTH  = 80;
const uint16_t image_data[] = {
  0x76bf, 0x76bf, 0x76bf, 0x76bf, 0x76bf, 0x76bf, 0x76bf, 0x76bf, 0x76bf, 0x76bf, 0x76bf, 0x76bf,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 0x76bf, 
  0x76bf, 0x76bf, 0x76bf, 0x76bf, 0x76bf, 0x76bf, 0x76bf, 0x76bf, 0x76bf, 0x76bf, 0x76bf, 0x76bf,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 0x76bf, 
  0x76bf, 0x76bf, 0x76bf, 0x76bf, 0x76bf, 0x76bf, 0x76bf, 0x76bf, 0x76bf, 0x76bf, 0x76bf, 0x76bf,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 0x76bf, 
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  0x76bf, 0x6e5d, 0x4cf4, 0x5557, 0x5db9, 0x4d15, 0x5db9, 0x5557, 0x4cf4, 0x5d98, 0x65da, 0x4cd3,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 0x76bf
};



/////////////////////////////////////////////////////////////



LGFX lcd;
int16_t x, y;
int mode = 1;
int x_fleche = 0;
int y_fleche = 0;
float distance;



void dessin_ecran(){

  // Cadre de bas d'ecran
  if      (mode == 1) {lcd.fillRect(0, 401, 80, 81, lcd.color565(0, 174, 242)); lcd.fillRect(81, 401, 80, 81, lcd.color565(118, 212, 255));}
  else if (mode == 2) {lcd.fillRect(81, 401, 80, 81, lcd.color565(0, 174, 242)); lcd.fillRect(0, 401, 80, 81, lcd.color565(118, 212, 255));}
  lcd.drawRect(-1, 400, 82, 81, TFT_BLACK);
  lcd.drawRect(80, 400, 81, 81, TFT_BLACK);
  lcd.drawRect(160, 400, 161, 81, TFT_BLACK);

  // Croix du joystick virtuel
  lcd.drawLine(140, 20, 180, 20, TFT_BLACK);
  lcd.drawLine(140, 300, 180, 300, TFT_BLACK);
  lcd.drawLine(20, 140, 20, 180, TFT_BLACK);
  lcd.drawLine(300, 140, 300, 180, TFT_BLACK);
  lcd.drawLine(160, 20, 160, 300, TFT_BLACK);
  lcd.drawLine(20, 160, 300, 160, TFT_BLACK);
  lcd.fillCircle(160, 160, 22, lcd.color565(118, 212, 255));
  lcd.drawCircle(160, 160, 22, TFT_BLACK);

  // Credits
  lcd.setTextColor(TFT_BLACK, lcd.color565(118, 212, 255));
  lcd.drawString("Conception par :", 5, 378, 1);
  lcd.drawString("Nathanael DEBREILLY, Eliez LE HUNSEC, Ilan CHANY", 5, 388, 1);
  lcd.pushImage(235, 5, IMAGE_WIDTH, IMAGE_HEIGHT, image_data);

  // Affichage direction appui
  if (x_fleche != 0 && y_fleche != 0){
    lcd.drawLine(160, 160, x_fleche, y_fleche, TFT_RED);
    lcd.drawLine(160, 161, x_fleche, y_fleche+1, TFT_RED);
    lcd.fillRect(x_fleche-5, y_fleche-5, 10, 10, TFT_RED);
  }
}



void setup() {

  Serial.begin(115200);
  pinMode(45, OUTPUT);
  digitalWrite(45, HIGH);

  lcd.init();
  lcd.setRotation(2);
  lcd.setColorDepth(16);
  lcd.setSwapBytes(true);
  lcd.invertDisplay(true);
  lcd.initTouch();

  lcd.fillRect(0, 0, 320, 480, lcd.color565(118, 212, 255));
  dessin_ecran();
}

void loop() {

  if (lcd.getTouch(&x, &y)) { // Si ecran touche

    if (x <= 80 && y >= 400) mode = 1; // Si bouton mode 1
  
    else if (x >= 80 && x <= 160 && y >= 400) mode = 2; // Si bouton mode 2

    else if (y <= 320){

      distance = sqrt(pow(x - 160, 2) + pow(y - 160, 2));
      lcd.drawLine(160, 160, x_fleche, y_fleche, lcd.color565(118, 212, 255));
      lcd.drawLine(160, 161, x_fleche, y_fleche+1, lcd.color565(118, 212, 255));
      lcd.fillRect(x_fleche-5, y_fleche-5, 10, 10, lcd.color565(118, 212, 255));
      
      if (distance <= 22){
        x_fleche = 0;
        y_fleche = 0;
      }

      else if (x >= 150 && x <= 170){
        x_fleche = 160;
        y_fleche = y;
      }

      else if (y >= 150 && y <= 170){
        x_fleche = x;
        y_fleche = 160;
      }

      else {
        x_fleche = x;
        y_fleche = y;
      }

    }

    dessin_ecran();
  }

  delay(16);
}














